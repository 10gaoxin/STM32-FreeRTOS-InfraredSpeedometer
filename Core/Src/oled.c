/**
  ******************************************************************************
  * @file    oled.c
  * @brief   0.96寸 OLED (SSD1306) I2C驱动实现
  ******************************************************************************
  */

#include "oled.h"
#include <string.h>

/* OLED显存 128*64/8 = 1024 字节 */
static uint8_t OLED_GRAM[128][8];

/* OLED设备状态：1=在线可用，0=未检测到 */
static uint8_t oled_ready = 0;
/* 运行时I2C地址（自动检测后设置） */
static uint8_t oled_i2c_addr = OLED_I2C_ADDR;

/* 6x8 ASCII字符字模 (ASCII 32-127) */
static const uint8_t OLED_F6x8[][6] = {
    {0x00,0x00,0x00,0x00,0x00,0x00}, // sp (32)
    {0x00,0x00,0x00,0x2F,0x00,0x00}, // !
    {0x00,0x00,0x07,0x00,0x07,0x00}, // "
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    {0x00,0x08,0x04,0x08,0x10,0x08}, // ~
};

/* 8x16 ASCII字符字模 (ASCII 32-127) */
static const uint8_t OLED_F8x16[][16] = {
    {0x00,0x00,0x00,0x00,0x00,0x00,0x00,0x00,0x00,0x00,0x00,0x00,0x00,0x00,0x00,0x00}, // sp
    {0x00,0x00,0x00,0xF8,0x00,0x00,0x00,0x00,0x00,0x00,0x00,0x33,0x30,0x00,0x00,0x00}, // !
    {0x00,0x10,0x0C,0x06,0x10,0x0C,0x06,0x00,0x00,0x00,0x00,0x00,0x00,0x00,0x00,0x00}, // "
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    {0x00,0x06,0x01,0x01,0x02,0x02,0x04,0x04,0x00,0x00,0x00,0x00,0x00,0x00,0x00,0x00}, // ~
};

/**
  * @brief  I2C总线恢复（当总线卡在BUSY状态时调用）
  */
static void I2C_Recovery(void)
{
    HAL_I2C_DeInit(&hi2c1);
    HAL_Delay(10);
    HAL_I2C_Init(&hi2c1);
}

/**
  * @brief  向OLED写入命令
  */
static void OLED_WriteCmd(uint8_t cmd)
{
    uint8_t data[2] = {0x00, cmd};  /* 0x00表示命令 */
    if (HAL_I2C_Master_Transmit(&hi2c1, oled_i2c_addr, data, 2, 10) != HAL_OK)
    {
        if (hi2c1.State == HAL_I2C_STATE_BUSY)
            I2C_Recovery();
    }
}

/**
  * @brief  向OLED写入数据（批量刷新时不直接调用，仅初始化序列使用）
  */
static void OLED_WriteData(uint8_t data)
{
    uint8_t buf[2] = {0x40, data};  /* 0x40表示数据 */
    HAL_I2C_Master_Transmit(&hi2c1, oled_i2c_addr, buf, 2, 10);
}

/**
  * @brief  检查OLED是否在线
  * @retval 1=在线，0=未找到
  */
uint8_t OLED_IsReady(void)
{
    return oled_ready;
}

/**
  * @brief  OLED初始化
  * @note   自动尝试 0x3C(0x78) 和 0x3D(0x7A) 两个常见地址
  */
void OLED_Init(void)
{
    HAL_Delay(100);  /* 等待OLED上电稳定 */

    /* 自动检测I2C地址：先尝试0x3C(0x78)，再尝试0x3D(0x7A) */
    oled_ready = 0;
    if (HAL_I2C_IsDeviceReady(&hi2c1, 0x78, 3, 50) == HAL_OK)
    {
        oled_i2c_addr = 0x78;
        oled_ready = 1;
    }
    else if (HAL_I2C_IsDeviceReady(&hi2c1, 0x7A, 3, 50) == HAL_OK)
    {
        oled_i2c_addr = 0x7A;
        oled_ready = 1;
    }

    if (!oled_ready) return;  /* 未检测到OLED，直接退出 */

    OLED_WriteCmd(0xAE);  /* 关闭显示 */
    OLED_WriteCmd(0x00);  /* 设置低列地址 */
    OLED_WriteCmd(0x10);  /* 设置高列地址 */
    OLED_WriteCmd(0x40);  /* 设置起始行地址 */
    OLED_WriteCmd(0xB0);  /* 设置页地址 */
    OLED_WriteCmd(0x81);  /* 对比度设置 */
    OLED_WriteCmd(0xFF);  /* 对比度值 (0x00~0xFF) */
    OLED_WriteCmd(0xA1);  /* 段重映射 (0xA0左右反置，0xA1正常) */
    OLED_WriteCmd(0xA6);  /* 正常显示 (0xA6正常，0xA7反色) */
    OLED_WriteCmd(0xA8);  /* 多路复用率 */
    OLED_WriteCmd(0x3F);  /* 1/64 duty */
    OLED_WriteCmd(0xC8);  /* COM扫描方向 (0xC0上下反置，0xC8正常) */
    OLED_WriteCmd(0xD3);  /* 显示偏移 */
    OLED_WriteCmd(0x00);  /* 无偏移 */
    OLED_WriteCmd(0xD5);  /* 时钟分频 */
    OLED_WriteCmd(0x80);  /* 分频值 */
    OLED_WriteCmd(0xD9);  /* 预充电周期 */
    OLED_WriteCmd(0xF1);  /* */
    OLED_WriteCmd(0xDA);  /* COM硬件配置 */
    OLED_WriteCmd(0x12);  /* */
    OLED_WriteCmd(0xDB);  /* VCOMH电压倍率 */
    OLED_WriteCmd(0x40);  /* */
    OLED_WriteCmd(0x8D);  /* 电荷泵设置 */
    OLED_WriteCmd(0x14);  /* 开启电荷泵 */
    OLED_WriteCmd(0xAF);  /* 打开显示 */

    OLED_Clear();
}

/**
  * @brief  清屏
  */
void OLED_Clear(void)
{
    uint8_t i, j;
    if (!oled_ready) return;
    for (i = 0; i < 8; i++)
    {
        for (j = 0; j < 128; j++)
        {
            OLED_GRAM[j][i] = 0x00;
        }
    }
    OLED_Refresh();
}

/**
  * @brief  刷新显存到OLED（批量传输：每页一次I2C，共8次，比单字节快128倍）
  */
void OLED_Refresh(void)
{
    uint8_t i, j;
    static uint8_t page_buf[129];  /* 静态：避免每次调用时在栈上分配129字节 */
    if (!oled_ready) return;
    for (i = 0; i < 8; i++)
    {
        OLED_WriteCmd(0xB0 + i);  /* 设置页地址 */
        OLED_WriteCmd(0x00);      /* 列地址低4位清零 */
        OLED_WriteCmd(0x10);      /* 列地址高4位清零 */
        page_buf[0] = 0x40;       /* 数据模式控制字节 */
        for (j = 0; j < 128; j++)
            page_buf[j + 1] = OLED_GRAM[j][i];
        HAL_I2C_Master_Transmit(&hi2c1, oled_i2c_addr, page_buf, 129, 20);
    }
}

/**
  * @brief  开启显示
  */
void OLED_Display_On(void)
{
    if (!oled_ready) return;
    OLED_WriteCmd(0x8D);  /* 电荷泵设置 */
    OLED_WriteCmd(0x14);  /* 开启电荷泵 */
    OLED_WriteCmd(0xAF);  /* 开启显示 */
}

/**
  * @brief  关闭显示
  */
void OLED_Display_Off(void)
{
    if (!oled_ready) return;
    OLED_WriteCmd(0x8D);  /* 电荷泵设置 */
    OLED_WriteCmd(0x10);  /* 关闭电荷泵 */
    OLED_WriteCmd(0xAE);  /* 关闭显示 */
}

/**
  * @brief  设置光标位置
  */
void OLED_SetCursor(uint8_t x, uint8_t y)
{
    if (!oled_ready) return;
    OLED_WriteCmd(0xB0 + y);
    OLED_WriteCmd(((x & 0xF0) >> 4) | 0x10);
    OLED_WriteCmd(x & 0x0F);
}

/**
  * @brief  画点
  * @param  x: 0~127
  * @param  y: 0~63
  * @param  mode: 1-点亮, 0-熄灭
  */
void OLED_DrawPoint(uint8_t x, uint8_t y, uint8_t mode)
{
    if (!oled_ready) return;
    uint8_t page, bit;

    if (x > 127 || y > 63) return;

    page = y / 8;
    bit = y % 8;

    if (mode)
        OLED_GRAM[x][page] |= (1 << bit);
    else
        OLED_GRAM[x][page] &= ~(1 << bit);
}

/**
  * @brief  画线
  */
void OLED_DrawLine(uint8_t x1, uint8_t y1, uint8_t x2, uint8_t y2)
{
    int16_t dx = x2 - x1;
    int16_t dy = y2 - y1;
    int16_t ux = ((dx > 0) << 1) - 1;
    int16_t uy = ((dy > 0) << 1) - 1;
    int16_t x = x1, y = y1, eps = 0;

    dx = (dx > 0) ? dx : -dx;
    dy = (dy > 0) ? dy : -dy;

    if (dx > dy)
    {
        for (x = x1; x != x2 + ux; x += ux)
        {
            OLED_DrawPoint(x, y, 1);
            eps += dy;
            if ((eps << 1) >= dx)
            {
                y += uy;
                eps -= dx;
            }
        }
    }
    else
    {
        for (y = y1; y != y2 + uy; y += uy)
        {
            OLED_DrawPoint(x, y, 1);
            eps += dx;
            if ((eps << 1) >= dy)
            {
                x += ux;
                eps -= dy;
            }
        }
    }
}

/**
  * @brief  画矩形
  */
void OLED_DrawRectangle(uint8_t x1, uint8_t y1, uint8_t x2, uint8_t y2)
{
    OLED_DrawLine(x1, y1, x2, y1);
    OLED_DrawLine(x1, y1, x1, y2);
    OLED_DrawLine(x1, y2, x2, y2);
    OLED_DrawLine(x2, y1, x2, y2);
}

/**
  * @brief  填充区域
  */
void OLED_Fill(uint8_t x1, uint8_t y1, uint8_t x2, uint8_t y2, uint8_t mode)
{
    uint8_t x, y;
    for (x = x1; x <= x2; x++)
    {
        for (y = y1; y <= y2; y++)
        {
            OLED_DrawPoint(x, y, mode);
        }
    }
}

/**
  * @brief  显示单个字符
  * @param  x: 0~127
  * @param  y: 0~63
  * @param  chr: 要显示的字符
  * @param  size: OLED_FONT_6X8 或 OLED_FONT_8X16
  */
void OLED_ShowChar(uint8_t x, uint8_t y, char chr, uint8_t size)
{
    uint8_t i, j;
    uint8_t c = chr - ' ';  /* 得到偏移后的值 */

    if (x > OLED_WIDTH - 1 || y > OLED_HEIGHT - 1) return;

    if (size == OLED_FONT_6X8)
    {
        for (i = 0; i < 6; i++)
        {
            uint8_t temp = OLED_F6x8[c][i];
            for (j = 0; j < 8; j++)
            {
                if (temp & 0x01)
                    OLED_DrawPoint(x + i, y + j, 1);
                else
                    OLED_DrawPoint(x + i, y + j, 0);
                temp >>= 1;
            }
        }
    }
    else /* OLED_FONT_8X16 */
    {
        for (i = 0; i < 8; i++)
        {
            /* 上半部分 */
            uint8_t temp = OLED_F8x16[c][i];
            for (j = 0; j < 8; j++)
            {
                if (temp & 0x01)
                    OLED_DrawPoint(x + i, y + j, 1);
                else
                    OLED_DrawPoint(x + i, y + j, 0);
                temp >>= 1;
            }
            /* 下半部分 */
            temp = OLED_F8x16[c][i + 8];
            for (j = 0; j < 8; j++)
            {
                if (temp & 0x01)
                    OLED_DrawPoint(x + i, y + 8 + j, 1);
                else
                    OLED_DrawPoint(x + i, y + 8 + j, 0);
                temp >>= 1;
            }
        }
    }
}

/**
  * @brief  显示字符串
  */
void OLED_ShowString(uint8_t x, uint8_t y, const char *str, uint8_t size)
{
    uint8_t charWidth = (size == OLED_FONT_6X8) ? 6 : 8;

    while (*str != '\0')
    {
        if (x > OLED_WIDTH - charWidth)
        {
            x = 0;
            y += (size == OLED_FONT_6X8) ? 8 : 16;
        }
        if (y > OLED_HEIGHT - 1)
        {
            y = 0;
            x = 0;
        }
        OLED_ShowChar(x, y, *str, size);
        x += charWidth;
        str++;
    }
}

/**
  * @brief  计算m的n次方
  */
static uint32_t OLED_Pow(uint32_t m, uint8_t n)
{
    uint32_t result = 1;
    while (n--)
        result *= m;
    return result;
}

/**
  * @brief  显示数字
  * @param  x, y: 起点坐标
  * @param  num: 数值 (0~4294967295)
  * @param  len: 显示位数
  * @param  size: 字体大小
  */
void OLED_ShowNum(uint8_t x, uint8_t y, uint32_t num, uint8_t len, uint8_t size)
{
    uint8_t i, temp;
    uint8_t charWidth = (size == OLED_FONT_6X8) ? 6 : 8;

    for (i = 0; i < len; i++)
    {
        temp = (num / OLED_Pow(10, len - i - 1)) % 10;
        OLED_ShowChar(x + i * charWidth, y, temp + '0', size);
    }
}

/**
  * @brief  显示浮点数
  * @param  x, y: 起点坐标
  * @param  num: 浮点数值
  * @param  intLen: 整数部分位数
  * @param  decLen: 小数部分位数
  * @param  size: 字体大小
  */
void OLED_ShowFloat(uint8_t x, uint8_t y, float num, uint8_t intLen, uint8_t decLen, uint8_t size)
{
    uint8_t charWidth = (size == OLED_FONT_6X8) ? 6 : 8;
    uint32_t intPart, decPart;
    uint8_t i, temp;
    uint8_t showNegative = 0;

    /* 处理负数 */
    if (num < 0)
    {
        showNegative = 1;
        num = -num;
    }

    intPart = (uint32_t)num;
    decPart = (uint32_t)((num - intPart) * OLED_Pow(10, decLen));

    /* 显示负号 */
    if (showNegative)
    {
        OLED_ShowChar(x, y, '-', size);
        x += charWidth;
    }

    /* 显示整数部分 */
    for (i = 0; i < intLen; i++)
    {
        temp = (intPart / OLED_Pow(10, intLen - i - 1)) % 10;
        OLED_ShowChar(x + i * charWidth, y, temp + '0', size);
    }

    /* 显示小数点 */
    x += intLen * charWidth;
    OLED_ShowChar(x, y, '.', size);
    x += charWidth;

    /* 显示小数部分 */
    for (i = 0; i < decLen; i++)
    {
        temp = (decPart / OLED_Pow(10, decLen - i - 1)) % 10;
        OLED_ShowChar(x + i * charWidth, y, temp + '0', size);
    }
}

/**
  * @brief  显示中文 (16x16)
  * @note   需要自行添加中文字模数组
  */
void OLED_ShowChinese(uint8_t x, uint8_t y, uint8_t index)
{
    /* 预留中文显示功能，需要添加字模数据 */
    (void)x;
    (void)y;
    (void)index;
}
